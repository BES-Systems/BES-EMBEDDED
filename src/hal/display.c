#include "bes/display.h"
#include "bes/gpio.h"
#include "bes/log.h"
#include "bes/device.h"

#include "driver/spi_master.h"
#include "driver/gpio.h"
#include "esp_lcd_io_spi.h"
#include "esp_lcd_panel_io.h"
#include "esp_lcd_panel_commands.h"
#include "esp_log.h"
#include "freertos/FreeRTOS.h"
#include "freertos/task.h"
#include "esp_heap_caps.h"
#include <string.h>

#define DISPLAY_WIDTH  240
#define DISPLAY_HEIGHT 320

#define PIN_NUM_MOSI   13
#define PIN_NUM_MISO   12
#define PIN_NUM_SCLK   14
#define PIN_NUM_CS     15
#define PIN_NUM_DC      2
#define PIN_NUM_RST     4
#define PIN_NUM_BCKL   21

#define SPI_HOST_ID     SPI2_HOST

#define CMD_RAMWR       0x2C
#define CMD_MADCTL      0x36
#define CMD_SLPOUT      0x11
#define CMD_DISPON      0x29

static esp_lcd_panel_io_handle_t s_io_handle = NULL;

static uint16_t *s_framebuf = NULL;

static const uint8_t ILI9341_INIT[] = {
    0xEF, 3, 0x03, 0x80, 0x02,
    0xCF, 3, 0x00, 0xC1, 0x30,
    0xED, 4, 0x64, 0x03, 0x12, 0x81,
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    0x29, 0x00,
};

static void send_cmd(uint8_t cmd)
{
    esp_lcd_panel_io_tx_param(
        s_io_handle,
        cmd,
        NULL,
        0
    );
}

static void send_param(const void *data, size_t len)
{
    esp_lcd_panel_io_tx_param(
        s_io_handle,
        0,
        data,
        len
    );
}
static void send_color(const void *data, size_t len)
{
    esp_lcd_panel_io_tx_color(s_io_handle, CMD_RAMWR, data, len);
}

static void ili9341_init_sequence(void)
{
    const uint8_t *p = ILI9341_INIT;
    size_t remaining = sizeof(ILI9341_INIT);

    while (remaining > 0)
    {
        uint8_t cmd = *p++;
        uint8_t argc = *p++;

        remaining -= 2;

        if(cmd == 0x00 && (argc & 0x80))
        {
            vTaskDelay(
                pdMS_TO_TICKS(
                    (argc & 0x7F) * 120
                )
            );

            continue;
        }


        esp_lcd_panel_io_tx_param(
            s_io_handle,
            cmd,
            p,
            argc
        );

        p += argc;
        remaining -= argc;
    }


    // MADCTL landscape
    send_cmd(0x36);

    uint8_t madctl = 0x28;

    send_param(
        &madctl,
        1
    );


    // RGB565
    send_cmd(0x3A);

    uint8_t pixel = 0x55;

    send_param(
        &pixel,
        1
    );


    vTaskDelay(
        pdMS_TO_TICKS(100)
    );
}

static inline uint16_t color565(uint8_t r, uint8_t g, uint8_t b)
{
    return ((r & 0xF8) << 8) | ((g & 0xFC) << 3) | (b >> 3);
}

void bes_display_init(void)
{
    bes_gpio_output(PIN_NUM_BCKL);

    gpio_config_t rst_conf = {
        .pin_bit_mask = (1ULL << PIN_NUM_RST),
        .mode = GPIO_MODE_OUTPUT,
    };

    gpio_config(&rst_conf);

    gpio_set_level(PIN_NUM_RST, 0);
    vTaskDelay(pdMS_TO_TICKS(20));

    gpio_set_level(PIN_NUM_RST, 1);
    vTaskDelay(pdMS_TO_TICKS(150));

    spi_bus_config_t bus_cfg = {
        .mosi_io_num = PIN_NUM_MOSI,
        .miso_io_num = -1,
        .sclk_io_num = PIN_NUM_SCLK,
        .quadwp_io_num = -1,
        .quadhd_io_num = -1,
        .max_transfer_sz = DISPLAY_WIDTH * DISPLAY_HEIGHT * 2,
    };
    spi_bus_initialize(SPI_HOST_ID, &bus_cfg, SPI_DMA_CH_AUTO);

    esp_lcd_panel_io_spi_config_t io_cfg = {
        .cs_gpio_num = PIN_NUM_CS,
        .dc_gpio_num = PIN_NUM_DC,
        .spi_mode = 0,
        .pclk_hz = 40 * 1000 * 1000,
        .trans_queue_depth = 10,
        .lcd_cmd_bits = 8,
        .lcd_param_bits = 8,
    };
    esp_lcd_new_panel_io_spi(SPI_HOST_ID, &io_cfg, &s_io_handle);

    ili9341_init_sequence();

    s_framebuf = heap_caps_malloc(DISPLAY_WIDTH * DISPLAY_HEIGHT * 2, MALLOC_CAP_SPIRAM | MALLOC_CAP_8BIT);
    if (!s_framebuf) {
        s_framebuf = heap_caps_malloc(DISPLAY_WIDTH * DISPLAY_HEIGHT * 2, MALLOC_CAP_8BIT);
    }

    bes_display_on();
    bes_log("Display initialized");

    bes_device_register(
        "display",
        NULL
    );
}

void bes_display_on(void)
{
    bes_gpio_write(PIN_NUM_BCKL, 1);
    send_cmd(CMD_DISPON);
}

void bes_display_off(void)
{
    send_cmd(0x28);
    bes_gpio_write(PIN_NUM_BCKL, 0);
}

void bes_display_fill(uint16_t color)
{
    for (int i = 0; i < DISPLAY_WIDTH * DISPLAY_HEIGHT; i++) {
        s_framebuf[i] = color;
    }

    uint8_t caset[4] = { 0, 0, (uint8_t)((DISPLAY_WIDTH - 1) >> 8), (uint8_t)(DISPLAY_WIDTH - 1) };
    send_cmd(0x2A);
    send_param(caset, 4);
    uint8_t raset[4] = { 0, 0, (uint8_t)((DISPLAY_HEIGHT - 1) >> 8), (uint8_t)(DISPLAY_HEIGHT - 1) };
    send_cmd(0x2B);
    send_param(raset, 4);

    send_color(s_framebuf, DISPLAY_WIDTH * DISPLAY_HEIGHT * 2);
}

static const uint8_t FONT_5X7[96][5] = {
    {0x00,0x00,0x00,0x00,0x00},{0x00,0x00,0x5F,0x00,0x00},{0x00,0x07,0x00,0x07,0x00},
    {0x14,0x7F,0x14,0x7F,0x14},{0x24,0x2A,0x7F,0x2A,0x12},{0x23,0x13,0x08,0x64,0x62},
    {0x36,0x49,0x55,0x22,0x50},{0x00,0x05,0x03,0x00,0x00},{0x00,0x1C,0x22,0x41,0x00},
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    {0x00,0x41,0x36,0x08,0x00},{0x10,0x08,0x08,0x10,0x08},
};

void bes_display_print(const char *text)
{
    bes_log("Drawing text");
    if(s_framebuf)
    {
        bes_log("Framebuffer OK");
    }
    else
    {
        bes_log("Framebuffer FAILED");
    }

    for(int i = 0; i < DISPLAY_WIDTH * DISPLAY_HEIGHT; i++)
    {
        s_framebuf[i] = 0xFFFF;
    }

    int x = 100;
    int y = 100;

    for (const char *p = text; *p; p++) {
        char c = *p;
        if (c == '\n') {
            x = 10;
            y += 8;
            continue;
        }
        if (c < 0x20 || c > 0x7E) c = '?';
        int idx = c - 0x20;

        for (int col = 0; col < 5; col++) {
            uint8_t bits = FONT_5X7[idx][col];
            for (int row = 0; row < 7; row++) {
                if (bits & (1 << row)) {
                    int px = x + col;
                    int py = y + row;
                    if (px < DISPLAY_WIDTH && py < DISPLAY_HEIGHT) {
                        for(int dx = 0; dx < 3; dx++)
                        {
                            for(int dy = 0; dy < 3; dy++)
                            {
                                s_framebuf[
                                    (py+dy)*DISPLAY_WIDTH+(px+dx)
                                ] = color565(255,255,255);
                            }
                        }
                    }
                }
            }
        }
        x += 6;
        if (x + 5 > DISPLAY_WIDTH) {
            x = 10;
            y += 8;
        }
    }

    uint8_t caset[4] = { 0, 0, (uint8_t)((DISPLAY_WIDTH - 1) >> 8), (uint8_t)(DISPLAY_WIDTH - 1) };
    send_cmd(0x2A);
    send_param(caset, 4);
    uint8_t raset[4] = { 0, 0, (uint8_t)((DISPLAY_HEIGHT - 1) >> 8), (uint8_t)(DISPLAY_HEIGHT - 1) };
    send_cmd(0x2B);
    send_param(raset, 4);

    send_color(s_framebuf, DISPLAY_WIDTH * DISPLAY_HEIGHT * 2);
}
